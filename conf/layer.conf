## conf/layer.conf
```bitbake
# We have a conf and classes directory, add to BBPATH
BBPATH .= ":${LAYERDIR}"

# We have recipes-* directories, add to BBFILES
BBFILES += "${LAYERDIR}/recipes-*/*/*.bb \
            ${LAYERDIR}/recipes-*/*/*.bbappend"

BBFILE_COLLECTIONS += "sensorhub"
BBFILE_PATTERN_sensorhub = "^${LAYERDIR}/"
BBFILE_PRIORITY_sensorhub = "14"

USERADDEXTENSION = "useradd-staticids"
USERADD_UID_TABLES += "conf/distro/include/sensorhub-passwd"
USERADD_GID_TABLES += "conf/distro/include/sensorhub-group"
```

## meta-core/conf/layer.conf
```bitbake
# We have a conf and classes directory, add to BBPATH
BBPATH .= ":${LAYERDIR}"

# We have recipes-* directories, add to BBFILES
BBFILES += "${LAYERDIR}/recipes-*/*/*.bb \
            ${LAYERDIR}/recipes-*/*/*.bbappend"

BBFILE_COLLECTIONS += "silverline-core"
BBFILE_PATTERN_silverline-core = "^${LAYERDIR}/"
BBFILE_PRIORITY_silverline-core = "12"

# This should only be incremented on significant changes that will
# cause compatibility issues with other layers
LAYERVERSION_silverline-core = "1"

# LAYERDEPENDS_skeleton = "core"
```

## meta-distro/conf/distro/silverline-distro.conf
```bitbake
require conf/distro/poky.conf



DISTRO = "silverline-distro"
DISTRO_NAME = "Silverline Distro"

# set the preferred version for kernel to the latest supported by  this build
PREFERRED_VERSION_linux-yocto = "4.1%"
# PREFERRED_VERSION_linux-raspberrypi = "4.1%"



PACKAGE_CLASSES = "package_ipk"
```

## meta-distro/conf/layer.conf
```bitbake
# We have a conf and classes directory, add to BBPATH
BBPATH := "${BBPATH}:${LAYERDIR}"

# We have a recipes directory, add to BBFILES
BBFILES := "${BBFILES} ${LAYERDIR}/recipes-*/*/*.bb \
        ${LAYERDIR}/recipes-*/*/*.bbappend"

BBFILE_COLLECTIONS += "silverline-distro"
BBFILE_PATTERN_silverline-distro := "^${LAYERDIR}/"
BBFILE_PRIORITY_silverline-distro = "10"
```

## meta-gigabyte/conf/layer.conf
```bitbake
# We have a conf and classes directory, add to BBPATH
BBPATH := "${BBPATH}:${LAYERDIR}"

# We have a recipes directory, add to BBFILES
BBFILES := "${BBFILES} ${LAYERDIR}/recipes-*/*/*.bb \
        ${LAYERDIR}/recipes-*/*/*.bbappend"

BBFILE_COLLECTIONS += "meta-gigabyte"
BBFILE_PATTERN_meta-gigabyte := "^${LAYERDIR}/"
BBFILE_PRIORITY_meta-gigabyte = "20"
```

## old-intel-quark/conf/layer.conf
```bitbake
# We have a conf and classes directory, add to BBPATH
BBPATH := "${BBPATH}:${LAYERDIR}"

# We have a recipes directory, add to BBFILES
BBFILES := "${BBFILES} ${LAYERDIR}/recipes-*/*/*.bb \
        ${LAYERDIR}/recipes-*/*/*.bbappend"

BBFILE_COLLECTIONS += "gigabyte-bsp"
BBFILE_PATTERN_gigabyte-bsp := "^${LAYERDIR}/"
BBFILE_PRIORITY_gigabyte-bsp = "6"
```
